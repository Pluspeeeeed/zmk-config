## config/west.yml
```yaml
manifest:
  defaults:
    remote: zmkfirmware
  remotes:
    - name: zmkfirmware
      url-base: https://github.com/zmkfirmware
    - name: urob
      url-base: https://github.com/urob
    # Additional modules containing boards/shields/custom code can be listed here as well
    # See https://docs.zephyrproject.org/3.2.0/develop/west/manifest.html#projects
  projects:
    - name: zmk
      remote: zmkfirmware
      revision: main
      import: app/west.yml
    - name: zmk-adaptive-key
      remote: urob
      revision: main
    - name: zmk-auto-layer # 提供 &num_word
      remote: urob
      revision: main
  self:
    path: config
```
