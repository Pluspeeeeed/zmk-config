/*
 * Copyright (c) 2020 The ZMK Contributors
 *
 * SPDX-License-Identifier: MIT
 */

#include <behaviors.dtsi>
#include <dt-bindings/zmk/keys.h>
#include <dt-bindings/zmk/bt.h>
#include <dt-bindings/zmk/ext_power.h>
#include <behaviors/num_word.dtsi>   // urob 的 zmk-auto-layer 模块，提供 &num_word



#include "keymaps/keynames_slk54w_4x6_3.h"     // key name defs for this board topology
#include "handsdown/vf-config.h"        // HD alpha keymap, adapt, combo definitions
#include "moutis/moutis_config.dtsi"    // my add-on feature defs

/ {
    behaviors { // separating these allows us to add board specific behaviors here (if any)

#include "moutis/moutis_behaviors.dtsi" // common behaviors (hold-taps, mod-morphs, lingers, adaptives)
#include HD_adapt_file                  // HDalpha/mnemonic based adaptives

    };

    macros {    // separating these allows us to add board specific macros here (if any)

#include "moutis/moutis_macros.dtsi"    // common macros (superset)

    };

    combos {    // separating these allows us to add board specific combos here (if any)
        compatible = "zmk,combos";

#include "moutis/moutis_combos.dtsi"    // common/location based combos (cut/copy/paste, esc, app, etc.)
#include HD_combo_file                  // HD alpha/mnemonic based combos (h-digraphs, etc.)

    };

#include "keymaps/keymap_slk54w_4x6_3.dtsi"    // consolidated keymap

};






/*

/ {
    behaviors { // separating these allows us to add board specific behaviors here (if any)

#include "moutis/moutis_behaviors.dtsi" // common behaviors (hold-taps, mod-morphs, lingers, adaptives)
#include HD_adapt_file                  // HDalpha/mnemonic based adaptives

        default_layer {
// ------------------------------------------------------------------------------------------------------------
// |  ESC  |  1  |  2  |  3   |  4   |  5   |                   |  6   |  7    |  8    |  9   |   0   | BSPC  |
// |   `   |  Q  |  W  |  E   |  R   |  T   |                   |  Y   |  U    |  I    |  O   |   P   |   -   |
// |  CTRL |  A  |  S  |  D   |  F   |  G   |                   |  H   |  J    |  K    |  L   |   ;   |   '   |
// | SHIFT | TAB |  Z  |  X   |  C   |  V   |   A |       |  A  |  N   |  M    |  ,    |  .   |   /   | ENTER |
//                     | ALT  | SPACE| GUI  |   A |       |  A  | RAISE| BSPC  | LOWER |
            bindings = <
&kp ESC   &kp N1 &kp N2 &kp N3   &kp N4   &kp N5                     &kp N6 &kp N7   &kp N8    &kp N9  &kp N0   &kp BSPC
&kp GRAVE &kp Q  &kp W  &kp E    &kp R    &kp T                      &kp Y  &kp U    &kp I     &kp O   &kp P    &kp MINUS
&kp LSHFT &kp A  &kp S  &kp D    &kp F    &kp G                      &kp H  &kp J    &kp K     &kp L   &kp SEMI &kp SQT
&kp LCTRL &kp TAB &kp Z &kp X    &kp C    &kp V       &none &none    &kp N  &kp M    &kp COMMA &kp DOT &kp FSLH &kp RET
                         &kp LALT &kp SPACE &kp LGUI  &none &none  &mo 2 &kp BSPC &mo 1
            >;

    macros {    // separating these allows us to add board specific macros here (if any)

#include "moutis/moutis_macros.dtsi"    // common macros (superset)

    };

    combos {    // separating these allows us to add board specific combos here (if any)
        compatible = "zmk,combos";

#include "moutis/moutis_combos.dtsi"    // common/location based combos (cut/copy/paste, esc, app, etc.)
#include HD_combo_file                  // HD alpha/mnemonic based combos (h-digraphs, etc.)

    };
};
*/
